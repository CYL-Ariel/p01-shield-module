#include <dt-bindings/zmk/matrix_transform.h>

/ {
    chosen {
        zmk,kscan = &kscan0;
        zmk,matrix_transform = &default_transform;
    };

    default_transform: keymap_transform_0 {
        compatible = "zmk,matrix-transform";
        columns = <16>;
        rows = <4>;
//         | SW1   | SW2   | SW3   | SW4   | SW5   | SW6   |                               | SW6   | SW5    | SW4    | SW3    | SW2    | SW1    |
// | SW7   | SW8   | SW9   | SW10  | SW11  | SW12  |                                               | SW12   | SW11   | SW10   | SW9    | SW8    | SW7    |
// | SW13  | SW14  | SW15  | SW16  | SW17  | SW18  | SW19  |                               | SW19  | SW18   | SW17   | SW16   | SW15   | SW14   | SW13   |
//                         | SW20  | SW21  | SW22  | SW23  | SW24  | SW25 || SW25  | SW24  | SW23  | SW22   | SW21   | SW20   | 
    map = <
            MATRIX_ROW_COL(0,1) MATRIX_ROW_COL(0,2) MATRIX_ROW_COL(0,3) MATRIX_ROW_COL(0,4) MATRIX_ROW_COL(0,5) MATRIX_ROW_COL(0,6)                                 MATRIX_ROW_COL(0,9) MATRIX_ROW_COL(0,10) MATRIX_ROW_COL(0,11) MATRIX_ROW_COL(0,12) MATRIX_ROW_COL(0,13) MATRIX_ROW_COL(0,14)
    MATRIX_ROW_COL(1,0) MATRIX_ROW_COL(1,1) MATRIX_ROW_COL(1,2) MATRIX_ROW_COL(1,3) MATRIX_ROW_COL(1,4) MATRIX_ROW_COL(1,5)                                                 MATRIX_ROW_COL(1,10) MATRIX_ROW_COL(1,11) MATRIX_ROW_COL(1,12) MATRIX_ROW_COL(1,13) MATRIX_ROW_COL(1,14) MATRIX_ROW_COL(1,15)
    MATRIX_ROW_COL(2,0) MATRIX_ROW_COL(2,1) MATRIX_ROW_COL(2,2) MATRIX_ROW_COL(2,3) MATRIX_ROW_COL(2,4) MATRIX_ROW_COL(2,5) MATRIX_ROW_COL(1,6)                                 MATRIX_ROW_COL(1,9) MATRIX_ROW_COL(2,10) MATRIX_ROW_COL(2,11) MATRIX_ROW_COL(2,12) MATRIX_ROW_COL(2,13) MATRIX_ROW_COL(2,14) MATRIX_ROW_COL(2,15)
                            MATRIX_ROW_COL(3,3) MATRIX_ROW_COL(3,4) MATRIX_ROW_COL(3,5) MATRIX_ROW_COL(2,6) MATRIX_ROW_COL(3,6) MATRIX_ROW_COL(3,7) MATRIX_ROW_COL(3,8) MATRIX_ROW_COL(3,9) MATRIX_ROW_COL(2,9) MATRIX_ROW_COL(3,10) MATRIX_ROW_COL(3,11) MATRIX_ROW_COL(3,12)
    >;
    };

    kscan0: kscan {
        compatible = "zmk,kscan-gpio-matrix";
        wakeup-source;

        diode-direction = "col2row";
        row-gpios
            = <&pro_micro 5 (GPIO_ACTIVE_HIGH | GPIO_PULL_DOWN)>
            , <&pro_micro 6 (GPIO_ACTIVE_HIGH | GPIO_PULL_DOWN)>
            , <&pro_micro 7 (GPIO_ACTIVE_HIGH | GPIO_PULL_DOWN)>
            , <&pro_micro 8 (GPIO_ACTIVE_HIGH | GPIO_PULL_DOWN)>
            ;
    };
};